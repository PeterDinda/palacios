## palacios/src/gears/Kconfig
```kconfig
menu GEARS

config GEARS
    bool "Enable GEARS in Palacios"
    default n
    help
      This is the Guest Examination and Revision Services, an extension used
      to modify guest code and implement guest-context VMM services in Palacios


config EXT_SW_INTERRUPTS
    bool "Enable interception and hooking of software interrupts"
    depends on GEARS
    default n
    help
      This feature will cause the VMM to intercept the execution
      of software interrupts (i.e. the INTn instruction) and enable
      any INT vector to be hooked. Extension name is "swintr_intercept"

config DEBUG_EXT_SW_INTERRUPTS
    bool "Enable debugging of software interrupt interception code"
    depends on GEARS
    depends on EXT_SW_INTERRUPTS
    default n
    help
      This will enable useful debugging printouts for software
      intercept code

config EXT_SWINTR_PASSTHROUGH
    bool "Hook all unhandled sofware interrupts for passthrough"
    depends on GEARS
    depends on EXT_SW_INTERRUPTS
    default n
    help
      If enabled, this will cause all software interrupts 
      (INT instruction vectors) to be hooked for passthrough.
      May reduce performance but useful for debugging.

config EXT_SYSCALL_HIJACK
    bool "Enable System Call Hijacking"
    default n
    depends on GEARS
    depends on EXT_SW_INTERRUPTS
    help
      Enable the VMM to hijack system calls executed by the guest.
      If enabled, the VMM will hook execution of INT 80


config EXT_SELECTIVE_SYSCALL_EXIT
    bool "Enable dynamic selective exiting of system calls"
    default n
    depends on GEARS
    depends on EXT_SYSCALL_HIJACK
    help
      If enabled, this option will allow the VMM to selectively
      enable and disable exiting on specific system calls.

config DEBUG_EXT_SYSCALL_HIJACK
    bool "Enable Syscall Hijack Debug in Palacios"
    depends on GEARS
    depends on EXT_SYSCALL_HIJACK
    default n
    help 
      Enable Debugging printouts for syscall hijacking code
      in Palacios


config EXT_SYSCALL_PASSTHROUGH
    bool "Hook all unhandled system calls for passthrough"
    depends on GEARS
    depends on EXT_SYSCALL_HIJACK
    default n
    help
      If enabled, this option will cause all system calls
      that are not explicitly hooked to be hooked for 
      passthrough. This is useful for debugging.

config EXT_EXECVE_HOOK
    bool "Hook calls to execve"
    depends on GEARS
    depends on EXT_SYSCALL_HIJACK
    default n
    help
      This option will cause the interception of all calls
      to the execve system call

config EXT_ENV_INJECT
	bool "Enable environment variable injection"
    depends on GEARS
	depends on EXT_EXECVE_HOOK
	default n
	help
	  Enables development extension for overriding env vars 
	  for certain executables

config EXT_CODE_INJECT
	bool "Allow code injection"
    depends on GEARS
	depends on EXT_SYSCALL_HIJACK
    depends on EXT_EXECVE_HOOK
	default n
	help
	  This option will allow code to be injected and run in the
	  guest context

config EXT_PRIV
    bool "Allow privileges to be given to code modules"
    depends on GEARS
    default n
    help
      This option allows different code modules in the guest to be
      given privileges such as uninhibited access to devices etc.

config DEBUG_EXT_PRIV
    bool "Allow privileged module debugging"
    depends on EXT_PRIV
    default n
    help
      Turns on debugging output for privilege extension

config EXT_GUARD_MODULES
    bool "Allow guarded execution of guest modules"
    depends on GEARS
    depends on EXT_PRIV
    default n
    help
      This option allows priveledge hardware access to kernel drivers/modules
      in the guest. Requires instrumentation of guest driver/module.

config DEBUG_EXT_GUARD_MODS
    bool "Allow guarded module debugging"
    depends on EXT_GUARD_MODULES
    default n
    help
      Turns on debugging output for guarded modules extension

endmenu
```

## palacios/src/interfaces/Kconfig
```kconfig
menu "Host Interfaces"

config FILE
        bool "Host support for file operations"
        default n
        help
          Select this if your host OS supports file operatoins and you want Palacios to be able to use them.
	
config KEYED_STREAMS
        bool "Host support for keyed streams"
        default n
        help
          Select this if your host OS supports keyed streams
          Palacios Checkpoint/Restore and Migration depends on this feature

config STREAM
	bool "Host support for streams"
	default n
    help
        Select this if your host OS supports streams
        Palacios serial ports and similar functions depend on this feature
          
config CONSOLE
	bool "Host support for VM text-mode console"
        default n
        help
          Select this if you want to forward a guest console interface to some host OS service
          This is for a TEXT MODE console.   Select the framebuffer console for graphics and text
            
config GRAPHICS_CONSOLE
        bool "Host support for VM graphics and text-mode console based on a frame buffer"
        default n
	help
          Select this if you want to forward a guest graphics-mode (and text-mode) console
          interface to some host OS service.  This is for a GRAPHICS console based on a shared frame buffer.
          Text mode output is RENDERED onto the framebuffer

config SOCKET
        bool "Host support for Network Sockets"
        default y
        help
          Select this if you host OS implements a socket API that is available to Palacios. This is required
          to support the internal networking features of Palacios.


config PACKET
        bool "Host support for Raw Packet Transmision"
        depends on EXPERIMENTAL
        default n
        help
      	  Select this if you host OS implements a raw packet network API that is available to Palacios. This is required
          to support the internal networking features of Palacios.


config HOST_PCI
	bool "Host PCI support"
	depends on EXPERIMENTAL
	default y
	help 
	  This enables host support for passthrough PCI devices

config HOST_DEVICE
        bool "Host device support"
        default n
	help
          Select this if you want to forward a guest device to a host-based decice implementation
          This makes it possible for virtual devices such as the generic device and the pci_front
          device to make host-based device implementations appear within the guest
          
config HOST_HYPERCALL
       bool "Host hypercall support"
       default n
       help
          Select this if you would like to make it possible
          to register host-based implementations of hypercalls,
          for example, implemented in Linux kernel modules

config HOST_PMU
       bool "Host PMU support"
       default n
       help
          Select this if you would like to access performance
          counters (the PMU) within Palacios

config HOST_PWRSTAT
	bool "Host power statistics monitoring support"
	default n
	help
		Select this if you would like to access energy/power
		measurements within Palacios

config HOST_PSTATE_CTRL
    bool "Host allows us control of P-states"
    default n
    help
      Select this if your host allows control of hardware P-states (DVFS)

config HOST_LAZY_FPU_SWITCH
	bool "Host provides lazy FPU context switching"
	default n
	help
		Select this if your host provides lazy context switch support
                for floating point state and you would like Palacios to use it
endmenu
```
