## Kconfig.stdlibs
```kconfig
menu "Standard library functions"

config BUILT_IN_STDLIB
	bool "Enable Built in versions of stdlib functions"
	help 
	  Not all host OSes provide link targets for stdlib functions
	  Palacios provides internal implementations of these functions, that you can select from this list

config BUILT_IN_MEMSET
	bool "memset()"
	default n
	depends on BUILT_IN_STDLIB
	help 
	  This enables Palacios' internal implementation of memset


config BUILT_IN_MEMCPY
	bool "memcpy()"
	default n
	depends on BUILT_IN_STDLIB
	help 
	  This enables Palacios' internal implementation of memcpy

config BUILT_IN_MEMMOVE
	bool "memmove()"
	default n
	depends on BUILT_IN_STDLIB
	help 
	  This enables Palacios' internal implementation of memmove

config BUILT_IN_MEMCMP
	bool "memcmp()"
	default n
	depends on BUILT_IN_STDLIB
	help 
	  This enables Palacios' internal implementation of memcmp

config BUILT_IN_STRLEN
	bool "strlen()"
	default n
	depends on BUILT_IN_STDLIB
	help 
	  This enables Palacios' internal implementation of strlen

config BUILT_IN_STRNLEN
	bool "strnlen()"
	default n
	depends on BUILT_IN_STDLIB
	help 
	  This enables Palacios' internal implementation of strnlen


config BUILT_IN_STRCMP
	bool "strcmp()"
	default n
	depends on BUILT_IN_STDLIB
	help 
	  This enables Palacios' internal implementation of strcmp


config BUILT_IN_STRCASECMP
	bool "strcasecmp()"
	depends on BUILT_IN_STDLIB
	help
	  This enables Palacios' internal implementation of strcasecmp

config BUILT_IN_STRNCMP
	bool "strncmp()"
	default n
	depends on BUILT_IN_STDLIB
	help 
	  This enables Palacios' internal implementation of strncmp

config BUILT_IN_STRNCASECMP
	bool "strncasecmp()"
	default n
	depends on BUILT_IN_STDLIB
	help
	  This enables Palacios' internal implementation of strncasecmp


config BUILT_IN_STRCAT
	bool "strcat()"
	default n
	depends on BUILT_IN_STDLIB
	help 
	  This enables Palacios' internal implementation of strcat

config BUILT_IN_STRNCAT
	bool "strncat()"
	default n
	depends on BUILT_IN_STDLIB
	help 
	  This enables Palacios' internal implementation of strncat

config BUILT_IN_STRCPY
	bool "strcpy()"
	default n
	depends on BUILT_IN_STDLIB
	help 
	  This enables Palacios' internal implementation of strcpy

config BUILT_IN_STRNCPY
	bool "strncpy()"
	default n
	depends on BUILT_IN_STDLIB
	help 
	  This enables Palacios' internal implementation of strncpy

config BUILT_IN_STRDUP
	bool "strdup()"
	default y
	depends on BUILT_IN_STDLIB
	help 
	  This enables Palacios' internal implementation of strdup

config BUILT_IN_STRSTR
	bool "strstr()"
	default n
	depends on BUILT_IN_STDLIB
	help
	  This enables Palacios internal implementation of strstr


config BUILT_IN_ATOI
	bool "atoi()"
	depends on BUILT_IN_STDLIB
	help 
	  This enables Palacios' internal implementation of atoi

config BUILT_IN_STRCHR
	bool "strchr()"
	default n
	depends on BUILT_IN_STDLIB
	help 
	  This enables Palacios' internal implementation of strchr

config BUILT_IN_STRRCHR
	bool "strrchr()"
	default n
	depends on BUILT_IN_STDLIB
	help 
	  This enables Palacios' internal implementation of strrchr

config BUILT_IN_STRPBRK
	bool "strpbrk()"
	default n
	depends on BUILT_IN_STDLIB
	help 
	  This enables Palacios' internal implementation of strpbrk


config BUILT_IN_STDIO
	bool "Enable Built in versions of stdio functions"
	default n
	help 
	  Not all host OSes provide link targets for stdio functions
	  Palacios provides internal implementations of these functions, that you can select from this list



config BUILT_IN_SPRINTF
	bool "sprintf()"
	default n
	depends on BUILT_IN_STDIO
	help 
	  This enables Palacios' internal implementation of sprintf


config BUILT_IN_SNPRINTF
	bool "snprintf()"
	default n
	depends on BUILT_IN_STDIO
	help 
	  This enables Palacios' internal implementation of snprintf


config BUILT_IN_VSPRINTF
	bool "vsprintf()"
	default n
	depends on BUILT_IN_STDIO
	help 
	  This enables Palacios' internal implementation of vsprintf


config BUILT_IN_VSNRPRINTF
	bool "vsnrprintf()"
	default n
	depends on BUILT_IN_STDIO
	help 
	  This enables Palacios' internal implementation of vsnrprintf


config BUILT_IN_USERSPACE_SYMS
	bool "Enable build in versions of user space symbols needed"
	default y
	help 
	  This enables a set of dummy symbols corresponding to user space. 
	  This is needed to link user space libraries such as XED.


config BUILT_IN_STDIN
	bool "FILE * stdin;"
	default y
	depends on BUILT_IN_USERSPACE_SYMS
	help 
	  Includes the stdin file pointer

config BUILT_IN_STDOUT
	bool "FILE * stdout;"
	default y
	depends on BUILT_IN_USERSPACE_SYMS
	help 
	  Includes the stdout file pointer

config BUILT_IN_STDERR
	bool "FILE * stderr;"
	default y
	depends on BUILT_IN_USERSPACE_SYMS
	help 
	  Includes the stderr file pointer


config BUILT_IN_FPRINTF
	bool "fprintf();"
	default y
	depends on BUILT_IN_USERSPACE_SYMS
	help 
	  Includes fprintf()

config BUILT_IN_PRINTF
	bool "printf();"
	default y
	depends on BUILT_IN_USERSPACE_SYMS
	help 
	  Includes printf();

config BUILT_IN_FFLUSH
	bool "fflush();"
	default y
	depends on BUILT_IN_USERSPACE_SYMS
	help 
	  Includes fflush()

config BUILT_IN_ABORT
	bool "abort();"
	default y
	depends on BUILT_IN_USERSPACE_SYMS
	help 
	  Includes abort();
	

endmenu
```

## modules/linux_mods/Kconfig
```kconfig
config LNX_KERN_MODS
	bool "Linux kernel modules"
	select LNX_MOD_32BIT
	select LNX_MOD_64BIT
	




config LNX_MOD_32BIT
	bool "32 bit modules"
	depends on LNX_KERN_MODS

config LNX_MOD_32BIT_TEST
	bool "Linux (i386) test module"
	default y if SYMMOD
	depends on LNX_MOD_32BIT
	help 
	    This is a simple 32 bit test Linux kernel module




config LNX_MOD_64BIT
	bool "64 bit modules" 
	depends on LNX_KERN_MODS
	default y		
```

## modules/v3_mods/Kconfig
```kconfig
config V3_MODS
	bool "V3VEE Symbiotic modules"
	select V3_MOD_32BIT
	select V3_MOD_64BIT
	




config V3_MOD_32BIT
	bool "32 bit modules"
	depends on V3_MODS

config V3_MOD_32BIT_TEST
	bool "V3 Sym (i386) test module"
	default y if SYMMOD
	depends on V3_MOD_32BIT
	help 
	    This is a simple 32 bit test Symbiotic Module




config V3_MOD_64BIT
	bool "64 bit modules" 
	depends on V3_MODS
	default y		
```

## modules/v3_mods/i386/Kconfig
```kconfig
config LINUX_KERN_MODS
	bool "Include Linux kernel modules"
	depends on SYMMOD

if LINUX_KERN_MODS 

config LINUX_TEST_MODULE
	bool "Linux test module"
	default y if SYMMOD
	depends on SYMMOD
	help 
	    This is a simple test linux kernel module


	

endif
```
